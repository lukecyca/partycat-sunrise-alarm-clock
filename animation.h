#define SUNRISE_FRAMES (974)
#define min(a,b) ((a)<(b)?(a):(b))

byte sunrise[SUNRISE_FRAMES][3] = {
  {1, 1, 1},
  {1, 1, 0},
  {1, 1, 0},
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  {255, 255, 255},
};

// Start to bring up the white LEDs over the last N frames
#define WHITE_OFFSET (300.)

int drawSunriseFrame() {
  int frame = (millis() - animationStartTime) * settings.fps / 1000;

  if (frame >= SUNRISE_FRAMES) {
    return 0;
  }

  Serial.println(frame);

  for (int i=0; i<8; i++) {
    int p = random(NUM_LEDS);
    pixels[p].R = sunrise[frame][0];
    pixels[p].G = sunrise[frame][1];
    pixels[p].B = sunrise[frame][2];
  }
  ledstrip.show(pixels);

  if (frame > SUNRISE_FRAMES - WHITE_OFFSET) {
    float level = min((frame + 1 - (SUNRISE_FRAMES - WHITE_OFFSET)) / WHITE_OFFSET, 1.0);
    analogWrite(WHITE_PIN, level * PWM_RANGE_FULL);
  }

  return 1;
}

#define FADE_CONSTANT (0.97)
int drawFadeoutFrame() {
  int more = 0;

  for (int i=0; i<NUM_LEDS; i++) {
    if (pixels[i].R || pixels[i].G || pixels[i].B) {
      pixels[i].R *= FADE_CONSTANT;
      pixels[i].G *= FADE_CONSTANT;
      pixels[i].B *= FADE_CONSTANT;
      more = 1;
    }
  }
  ledstrip.show(pixels);

  // FIXME: Currently fading out the white channel by tracking
  // an arbitrary pixel's R value!
  analogWrite(WHITE_PIN, pixels[NUM_LEDS-1].R * PWM_RANGE_FULL / 256);

  return more;
}
